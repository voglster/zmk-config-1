#define CONFIG_WIRELESS

// 42-key (3x6+3) Corne with outer pinky column hardcoded across all layers.
// Outer column: Tab/Esc/LShift on left, Bspc/Enter/RShift on right.
// Thumbs (urob's 6-thumb layout preserved): outer = LGUI / smart_mouse;
// middle/inner come from base.keymap via LH/RH positional args.
#define ZMK_BASE_LAYER(name, LT, RT, LM, RM, LB, RB, LH, RH)                   \
    ZMK_LAYER(                                                                 \
        name,                                                                  \
        &kp TAB    LT RT &kp BSPC                                              \
        &kp ESC    LM RM &kp ENTER                                             \
        &kp LSHFT  LB RB &kp RSHFT                                             \
        &kp LGUI LH RH &smart_mouse                                            \
    )

#include "zmk-helpers/key-labels/42.h"
#include "base.keymap"

/{ chosen { zmk,physical-layout = &foostan_corne_6col_layout; }; };
